## fs/odinfs/Kconfig
```kconfig
config ODINFS_FS
	tristate "ODINFS"
	depends on HAS_IOMEM
	select CRC16
	help
	   If your system has a block of fast (comparable in access speed to
	   system memory) and non-volatile byte-addressable memory and you wish to
	   mount a light-weight, full-featured, and space-efficient filesystem over
	   it, say Y here, and read <file:Documentation/filesystems/odinfs.txt>.

	   To compile this as a module,  choose M here: the module will be
	   called odinfs.

config ODINFS_XIP
	bool "Execute-in-place in ODINFS"
	depends on ODINFS_FS && BLOCK
	help
	   Say Y here to enable XIP feature of ODINFS.

config ODINFS_WRITE_PROTECT
	bool "ODINFS write protection"
	depends on ODINFS_FS && MMU && HAVE_SET_MEMORY_RO
	default y
	help
	   Say Y here to enable the write protect feature of ODINFS.

config ODINFS_TEST
	bool
	depends on ODINFS_FS

config ODINFS_TEST_MODULE
	tristate "ODINFS Test"
	depends on ODINFS_FS && ODINFS_WRITE_PROTECT && m
	select ODINFS_TEST
	help
	  Say Y here to build a simple module to test the protection of
	  ODINFS. The module will be called odinfs_test.
```

## fs/parfs/Kconfig
```kconfig
config SLFS
    tristate "Single Level File System support"
    select DEV_DAX_PMEM
    help
     This is a file system for non-volatile memory. It use a single level design and use a little memory.

config SLFS_XIP
    bool "Execute-in-place in SLFS"
    depends on SLFS
    help
     Say Y here to enable XIP feature of SLFS.

config SLFS_DEBUG
    bool "SLFS debug log support"
    depends on SLFS
    help
     Enables run-time debug log support for the SLFS filesystem.
    
config SLFS_TRACE
    bool "SLFS trace support"
    depends on SLFS
    help
     Enables run-time trace log support for the SLFS filesystem.
```

## fs/winefs/Kconfig
```kconfig
config WINEFS_FS
	tristate "WineFS"
	depends on FS_DAX 
	select CRC16
	help
	   If your system has a block of fast (comparable in access speed to
	   system memory) and non-volatile byte-addressable memory and you wish to
	   mount a light-weight, full-featured, and space-efficient filesystem over
	   it, say Y here, and read <file:Documentation/filesystems/pmfs.txt>.

	   To compile this as a module,  choose M here: the module will be
	   called pmfs.

config WINEFS_XIP
	bool "Execute-in-place in WineFS"
	depends on WINEFS_FS && BLOCK
	help
	   Say Y here to enable XIP feature of WineFS.

config WINEFS_WRITE_PROTECT
	bool "WINEFS write protection"
	depends on WINEFS_FS && MMU && HAVE_SET_MEMORY_RO
	default y
	help
	   Say Y here to enable the write protect feature of WineFS.

config WINEFS_TEST
	bool
	depends on WINEFS_FS

config WINEFS_TEST_MODULE
	tristate "WINEFS Test"
	depends on WINEFS_FS && WINEFS_WRITE_PROTECT && m
	select WINEFS_TEST
	help
	  Say Y here to build a simple module to test the protection of
	  PMFS. The module will be called pmfs_test.
```
